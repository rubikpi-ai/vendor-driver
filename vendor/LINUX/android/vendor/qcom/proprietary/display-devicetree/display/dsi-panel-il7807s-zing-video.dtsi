/* Copyright (c) 2019, The Linux Foundation. All rights reserved.
 *
 * This program is free software; you can redistribute it and/or modify
 * it under the terms of the GNU General Public License version 2 and
 * only version 2 as published by the Free Software Foundation.
 *
 * This program is distributed in the hope that it will be useful,
 * but WITHOUT ANY WARRANTY; without even the implied warranty of
 * MERCHANTABILITY or FITNESS FOR A PARTICULAR PURPOSE.  See the
 * GNU General Public License for more details.
 */
&mdss_mdp {
	dsi_il7807s_zing_video: qcom,mdss_dsi_il7807s_zing_video {
		qcom,mdss-dsi-panel-name = "il7807s zing video mode dsi panel";
		qcom,mdss-dsi-panel-type = "dsi_video_mode";
		qcom,mdss-dsi-virtual-channel-id = <0>;
		qcom,mdss-dsi-stream = <0>;
		qcom,mdss-dsi-h-left-border = <0>;
		qcom,mdss-dsi-h-right-border = <0>;
		qcom,mdss-dsi-v-top-border = <0>;
		qcom,mdss-dsi-v-bottom-border = <0>;
		qcom,dsi-ctrl-num = <0>;
		qcom,dsi-phy-num = <0>;
		qcom,mdss-dsi-bpp = <24>;
		qcom,mdss-dsi-underflow-color = <0xff>;
		qcom,mdss-dsi-border-color = <0>;
		qcom,mdss-dsi-traffic-mode = "burst_mode";
		qcom,mdss-dsi-bllp-eof-power-mode;
		qcom,mdss-dsi-bllp-power-mode;
		qcom,mdss-dsi-lane-0-state;
		qcom,mdss-dsi-lane-1-state;
		qcom,mdss-dsi-lane-2-state;
		qcom,mdss-dsi-lane-3-state;
		qcom,mdss-dsi-force-clock-lane-hs;
		qcom,mdss-dsi-lp11-init;
		qcom,mdss-dsi-t-clk-post = <0x0d>;
		qcom,mdss-dsi-t-clk-pre = <0x33>;
		qcom,mdss-dsi-dma-trigger = "trigger_sw";
		qcom,mdss-dsi-mdp-trigger = "none";
		qcom,mdss-pan-physical-width-dimension = <87>;
		qcom,mdss-pan-physical-height-dimension = <155>;
		qcom,mdss-dsi-reset-sequence = <1 5>, <0 2>, <1 5>;
		qcom,mdss-dsi-display-timings {
			timing@0 {
				qcom,mdss-dsi-panel-width = <1080>;
				qcom,mdss-dsi-panel-height = <1920>;
				qcom,mdss-dsi-h-front-porch = <72>;
				qcom,mdss-dsi-h-back-porch = <60>;
				qcom,mdss-dsi-h-pulse-width = <24>;
				qcom,mdss-dsi-h-sync-skew = <0>;
				qcom,mdss-dsi-v-back-porch = <10>;
				qcom,mdss-dsi-v-front-porch = <40>;
				qcom,mdss-dsi-v-pulse-width = <4>;
				qcom,mdss-dsi-panel-framerate = <60>;
				qcom,mdss-dsi-on-command = [
					29 01 00 00 00 00 04 FF 78 07 01
					29 01 00 00 00 00 02 00 44
					29 01 00 00 00 00 02 01 01
					29 01 00 00 00 00 02 02 27
					29 01 00 00 00 00 02 03 2C
					29 01 00 00 00 00 02 04 00
					29 01 00 00 00 00 02 05 00
					29 01 00 00 00 00 02 06 00
					29 01 00 00 00 00 02 07 00
					29 01 00 00 00 00 02 08 82
					29 01 00 00 00 00 02 09 04
					29 01 00 00 00 00 02 0a 30
					29 01 00 00 00 00 02 0b 00
					29 01 00 00 00 00 02 0c 00
					29 01 00 00 00 00 02 0d 00
					29 01 00 00 00 00 02 0e 09
					29 01 00 00 00 00 02 31 07
					29 01 00 00 00 00 02 32 07
					29 01 00 00 00 00 02 33 07
					29 01 00 00 00 00 02 34 07
					29 01 00 00 00 00 02 35 07
					29 01 00 00 00 00 02 36 07
					29 01 00 00 00 00 02 37 2e
					29 01 00 00 00 00 02 38 2f
					29 01 00 00 00 00 02 39 30
					29 01 00 00 00 00 02 3a 2e
					29 01 00 00 00 00 02 3b 2f
					29 01 00 00 00 00 02 3c 30
					29 01 00 00 00 00 02 3d 40
					29 01 00 00 00 00 02 3e 08
					29 01 00 00 00 00 02 3f 13
					29 01 00 00 00 00 02 40 11
					29 01 00 00 00 00 02 41 12
					29 01 00 00 00 00 02 42 10
					29 01 00 00 00 00 02 43 00
					29 01 00 00 00 00 02 44 01
					29 01 00 00 00 00 02 45 07
					29 01 00 00 00 00 02 46 07
					29 01 00 00 00 00 02 47 28
					29 01 00 00 00 00 02 48 2c
					29 01 00 00 00 00 02 49 07
					29 01 00 00 00 00 02 4a 07
					29 01 00 00 00 00 02 4b 07
					29 01 00 00 00 00 02 4c 07
					29 01 00 00 00 00 02 4d 07
					29 01 00 00 00 00 02 4e 07
					29 01 00 00 00 00 02 4f 2e
					29 01 00 00 00 00 02 50 2f
					29 01 00 00 00 00 02 51 30
					29 01 00 00 00 00 02 52 2e
					29 01 00 00 00 00 02 53 2f
					29 01 00 00 00 00 02 54 30
					29 01 00 00 00 00 02 55 40
					29 01 00 00 00 00 02 56 08
					29 01 00 00 00 00 02 57 13
					29 01 00 00 00 00 02 58 11
					29 01 00 00 00 00 02 59 12
					29 01 00 00 00 00 02 5a 10
					29 01 00 00 00 00 02 5b 00
					29 01 00 00 00 00 02 5c 01
					29 01 00 00 00 00 02 5d 07
					29 01 00 00 00 00 02 5e 07
					29 01 00 00 00 00 02 5f 28
					29 01 00 00 00 00 02 60 2c
					29 01 00 00 00 00 02 61 07
					29 01 00 00 00 00 02 62 07
					29 01 00 00 00 00 02 63 07
					29 01 00 00 00 00 02 64 07
					29 01 00 00 00 00 02 65 07
					29 01 00 00 00 00 02 66 07
					29 01 00 00 00 00 02 67 2e
					29 01 00 00 00 00 02 68 2f
					29 01 00 00 00 00 02 69 30
					29 01 00 00 00 00 02 6a 2e
					29 01 00 00 00 00 02 6b 2f
					29 01 00 00 00 00 02 6c 30
					29 01 00 00 00 00 02 6d 40
					29 01 00 00 00 00 02 6e 08
					29 01 00 00 00 00 02 6f 12
					29 01 00 00 00 00 02 70 10
					29 01 00 00 00 00 02 71 13
					29 01 00 00 00 00 02 72 11
					29 01 00 00 00 00 02 73 00
					29 01 00 00 00 00 02 74 01
					29 01 00 00 00 00 02 75 07
					29 01 00 00 00 00 02 76 07
					29 01 00 00 00 00 02 77 28
					29 01 00 00 00 00 02 78 2C
					29 01 00 00 00 00 02 79 07
					29 01 00 00 00 00 02 7a 07
					29 01 00 00 00 00 02 7b 07
					29 01 00 00 00 00 02 7c 07
					29 01 00 00 00 00 02 7d 07
					29 01 00 00 00 00 02 7e 07
					29 01 00 00 00 00 02 7f 2e
					29 01 00 00 00 00 02 80 2f
					29 01 00 00 00 00 02 81 30
					29 01 00 00 00 00 02 82 2e
					29 01 00 00 00 00 02 83 2f
					29 01 00 00 00 00 02 84 30
					29 01 00 00 00 00 02 85 40
					29 01 00 00 00 00 02 86 08
					29 01 00 00 00 00 02 87 12
					29 01 00 00 00 00 02 88 10
					29 01 00 00 00 00 02 89 13
					29 01 00 00 00 00 02 8a 11
					29 01 00 00 00 00 02 8b 00
					29 01 00 00 00 00 02 8c 01
					29 01 00 00 00 00 02 8d 07
					29 01 00 00 00 00 02 8e 07
					29 01 00 00 00 00 02 8f 28
					29 01 00 00 00 00 02 90 2c
					29 01 00 00 00 00 02 B2 01
					29 01 00 00 00 00 02 c0 07
					29 01 00 00 00 00 02 c1 00
					29 01 00 00 00 00 02 c2 00
					29 01 00 00 00 00 02 c3 50
					29 01 00 00 00 00 02 c4 00
					29 01 00 00 00 00 02 c5 2b
					29 01 00 00 00 00 02 c6 28
					29 01 00 00 00 00 02 c7 28
					29 01 00 00 00 00 02 c8 00
					29 01 00 00 00 00 02 c9 00
					29 01 00 00 00 00 02 ca 01
					29 01 00 00 00 00 02 d0 01
					29 01 00 00 00 00 02 d1 12
					29 01 00 00 00 00 02 d2 00
					29 01 00 00 00 00 02 d3 41
					29 01 00 00 00 00 02 d4 04
					29 01 00 00 00 00 02 d5 22
					29 01 00 00 00 00 02 d6 41
					29 01 00 00 00 00 02 d7 00
					29 01 00 00 00 00 02 d8 60
					29 01 00 00 00 00 02 d9 a5
					29 01 00 00 00 00 02 da 00
					29 01 00 00 00 00 02 db 00
					29 01 00 00 00 00 02 dc 00
					29 01 00 00 00 00 02 dd 18
					29 01 00 00 00 00 02 de 01
					29 01 00 00 00 00 02 df 60
					29 01 00 00 00 00 02 e0 08
					29 01 00 00 00 00 02 e1 00
					29 01 00 00 00 00 02 e2 03
					29 01 00 00 00 00 02 e3 00
					29 01 00 00 00 00 02 e4 21
					29 01 00 00 00 00 02 e5 0f
					29 01 00 00 00 00 02 e6 22
					29 01 00 00 00 00 02 ee 01
					29 01 00 00 00 00 04 FF 78 07 02
					29 01 00 00 00 00 02 40 0C
					29 01 00 00 00 00 02 41 00
					29 01 00 00 00 00 02 42 0B
					29 01 00 00 00 00 02 43 31
					29 01 00 00 00 00 02 75 00
					29 01 00 00 00 00 02 46 42
					29 01 00 00 00 00 02 47 03
					29 01 00 00 00 00 02 01 55
					29 01 00 00 00 00 02 6B 11
					29 01 00 00 00 00 02 82 32
					29 01 00 00 00 00 02 1B 02
					29 01 00 00 00 00 02 06 86
					29 01 00 00 00 00 02 08 00
					29 01 00 00 00 00 02 0E 16
					29 01 00 00 00 00 02 0F 14
					29 01 00 00 00 00 04 FF 78 07 05
					29 01 00 00 00 00 02 1F 00
					29 01 00 00 00 00 02 20 80
					29 01 00 00 00 00 02 61 CB
					29 01 00 00 00 00 02 64 EF
					29 01 00 00 00 00 02 6E 3F
					29 01 00 00 00 00 02 69 02
					29 01 00 00 00 00 02 70 C8
					29 01 00 00 00 00 02 72 6E
					29 01 00 00 00 00 02 73 1C
					29 01 00 00 00 00 02 74 55
					29 01 00 00 00 00 02 76 7D
					29 01 00 00 00 00 02 7A 3F
					29 01 00 00 00 00 02 7B 6A
					29 01 00 00 00 00 02 7C 6A
					29 01 00 00 00 00 02 B5 50
					29 01 00 00 00 00 02 B7 70
					29 01 00 00 00 00 02 C9 90
					29 01 00 00 00 00 02 C6 1B
					29 01 00 00 00 00 02 56 FF
					29 01 00 00 00 00 04 FF 78 07 06
					29 01 00 00 00 00 02 C3 06
					29 01 00 00 00 00 02 13 13
					29 01 00 00 00 00 04 FF 78 07 08
					29 01 00 00 00 00 20 E0 00 00 12 32 00 64 8B AD 14 E1 0B 4B 25 7C C8 04 2A 3F 82 AD 3E E5 0E 3A 3F 55 7E B5 0F D6 D9
					29 01 00 00 00 00 20 E1 00 00 12 32 00 64 8B AD 14 E1 0B 4B 25 7C C8 04 2A 3F 82 AD 3E E5 0E 3A 3F 55 7E B5 0F D6 D9
					29 01 00 00 00 00 04 FF 78 07 0B
					29 01 00 00 00 00 02 94 88
					29 01 00 00 00 00 02 95 23
					29 01 00 00 00 00 02 96 0B
					29 01 00 00 00 00 02 97 0B
					29 01 00 00 00 00 02 98 C6
					29 01 00 00 00 00 02 99 C6
					29 01 00 00 00 00 02 9A 08
					29 01 00 00 00 00 02 9B 71
					29 01 00 00 00 00 02 9C 06
					29 01 00 00 00 00 02 9D 06
					29 01 00 00 00 00 02 9E D3
					29 01 00 00 00 00 02 9F D3
					29 01 00 00 00 00 02 AA 02
					29 01 00 00 00 00 02 AB E0
					29 01 00 00 00 00 04 FF 78 07 0C
					29 01 00 00 00 00 02 80 24
					29 01 00 00 00 00 02 81 39
					29 01 00 00 00 00 02 82 23
					29 01 00 00 00 00 02 83 32
					29 01 00 00 00 00 02 84 23
					29 01 00 00 00 00 02 85 33
					29 01 00 00 00 00 02 86 23
					29 01 00 00 00 00 02 87 31
					29 01 00 00 00 00 02 88 23
					29 01 00 00 00 00 02 89 2D
					29 01 00 00 00 00 02 8A 24
					29 01 00 00 00 00 02 8B 36
					29 01 00 00 00 00 02 8C 23
					29 01 00 00 00 00 02 8D 2C
					29 01 00 00 00 00 02 8E 23
					29 01 00 00 00 00 02 8F 30
					29 01 00 00 00 00 02 90 24
					29 01 00 00 00 00 02 91 35
					29 01 00 00 00 00 02 92 23
					29 01 00 00 00 00 02 93 2E
					29 01 00 00 00 00 02 94 24
					29 01 00 00 00 00 02 95 3A
					29 01 00 00 00 00 02 96 24
					29 01 00 00 00 00 02 97 37
					29 01 00 00 00 00 02 98 24
					29 01 00 00 00 00 02 99 34
					29 01 00 00 00 00 02 9A 23
					29 01 00 00 00 00 02 9B 2F
					29 01 00 00 00 00 02 9C 24
					29 01 00 00 00 00 02 9D 38
					29 01 00 00 00 00 04 FF 78 07 0E
					29 01 00 00 00 00 02 00 A3
					29 01 00 00 00 00 02 02 0F
					29 01 00 00 00 00 02 04 06
					29 01 00 00 00 00 02 13 04
					29 01 00 00 00 00 02 41 10
					29 01 00 00 00 00 02 42 02
					29 01 00 00 00 00 02 43 10
					29 01 00 00 00 00 02 44 82
					29 01 00 00 00 00 02 40 07
					29 01 00 00 00 00 02 45 0A
					29 01 00 00 00 00 02 46 D6
					29 01 00 00 00 00 02 47 00
					29 01 00 00 00 00 02 49 F0
					29 01 00 00 00 00 02 B0 01
					29 01 00 00 00 00 02 B1 7A
					29 01 00 00 00 00 02 C0 02
					29 01 00 00 00 00 02 C2 7A
					29 01 00 00 00 00 02 C3 7A
					29 01 00 00 00 00 02 C4 7A
					29 01 00 00 00 00 02 C5 7A
					29 01 00 00 00 00 02 C6 7A
					29 01 00 00 00 00 02 C7 7A
					29 01 00 00 00 00 02 C8 7A
					29 01 00 00 00 00 02 C9 7A
					29 01 00 00 00 00 02 4D F3
					29 01 00 00 00 00 02 50 00
					29 01 00 00 00 00 02 4B 0E
					29 01 00 00 00 00 04 FF 78 07 1E
					29 01 00 00 00 00 02 C9 02
					29 01 00 00 00 00 02 C0 1F
					29 01 00 00 00 00 02 C1 1D
					29 01 00 00 00 00 02 C2 6B
					29 01 00 00 00 00 02 C3 6B
					29 01 00 00 00 00 02 C4 15
					29 01 00 00 00 00 02 C7 00
					29 01 00 00 00 00 04 FF 78 07 00
					05 01 00 00 78 00 02 11 00
					05 01 00 00 14 00 02 29 00
					05 01 00 00 00 00 02 35 00];
				qcom,mdss-dsi-off-command =[
					05 01 00 00 28 00 02 28 00
					05 01 00 00 78 00 02 10 00
				];
				qcom,mdss-dsi-on-command-state = "dsi_lp_mode";
				qcom,mdss-dsi-off-command-state = "dsi_hs_mode";
				qcom,mdss-dsi-h-sync-pulse = <0>;
				qcom,cmd-to-video-mode-post-switch-commands = [
					32 01 00 00 00 00 02 00 00];
				qcom,cmd-to-video-mode-post-switch-commands-state =
					"dsi_lp_mode";
			};
		};
	};
};

